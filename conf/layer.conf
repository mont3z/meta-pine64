## conf/layer.conf
```bitbake
#We have a conf and classes directory, add to BBPATH
BBPATH .= ":${LAYERDIR}"

# We have a recipes-* directories, add to BBFILES
BBFILES += "${LAYERDIR}/recipes-*/*/*.bb \
	${LAYERDIR}/recipes-*/*/*.bbappend"

BBFILE_COLLECTIONS += "pine64"
BBFILE_PATTERN_pine64 := "^${LAYERDIR}/"
BBFILE_PRIORITY_pine64 = "6"

LAYERDEPENDS_pine64 = "linaro linaro-toolchain"
LAYERVERSION_pine64 = "0.82"
```

## conf/machine/pine64.conf
```bitbake
#@TYPE: Machine
#@NAME: pine64

#@DESCRIPTION: Machine configuration for pine64 systems

require conf/machine/include/arm/arch-arm64.inc

PREFERRED_PROVIDER_virtual/xserver = "xserver-xorg"
XSERVER = "xserver-xorg \
           xf86-video-fbturbo \
           xf86-input-evdev \
           xf86-input-mouse \
           xf86-input-keyboard"

MACHINE_ESSENTIAL_EXTRA_RRECOMMENDS = " kernel-modules"
# kernel-base contains the module deps files, and depends on kernel, which
# sucks in the kernel image, which just plain sucks if you only want the
# modules in your filesystem image.
# BAD_RECOMMENDATIONS = "kernel kernel-image kernel-image-image virtual/kernel"

PREFERRED_PROVIDER_virtual/bootloader = "u-boot-pine64"
PREFERRED_PROVIDER_virtual/kernel = "linux-pine64"
KERNEL_IMAGETYPE ?= "Image"
OLDEST_KERNEL_pine64 = "3.10.0"

KERNEL_DEVICETREE = "pine64.dtb pine64noplus.dtb"
IMAGE_FSTYPES ?= "tar.bz2 wic"
WKS_FILE ?= "pine64-bsp-image.wks"
IMAGE_BOOT_FILES ?= " \
    Image-pine64.dtb;pine64.dtb \
    Image-pine64noplus.dtb;pine64noplus.dtb \
    Image-pine64.bin;Image \
    boot-pine64.scr;boot.scr \
    "
do_image_wic[depends] += "mtools-native:do_populate_sysroot dosfstools-native:do_populate_sysroot"

SERIAL_CONSOLE ?= "115200 ttyS0"
MACHINE_FEATURES ?= "alsa apm keyboard rtc serial screen usbgadget usbhost vfat"
```

## scripts/lib/wic/canned-wks/pine64-bsp-image.wks
```
# short-description: Create Pine64 BSP-style SD card image
# long-description: Creates a partitioned SD card image. Boot files
# are located in the first vfat partition and raw bootloaders are
# placed where they would be in BSP builds.

#
# The disk layout used is:
#
#    0                   -> reserverd
#    8 KiB               -> boot0  
#    19096 KiB           -> u-boot 
#    20480 KiB           -> kernel, dtbs, boot script
#    20480 KiB + 50 MiB  -> rootfs
#

part boot0 --source rawcopy --sourceparams="file=boot0.bin" --ondisk mmcblk --no-table --align 8
part loaders --source rawcopy --sourceparams="file=u-boot-with-dtb.bin" --ondisk mmcblk --no-table --align 19096
part /boot --source bootimg-partition --ondisk mmcblk --fstype=vfat --label pine64 --active --size=50M --align 20480
part / --source rootfs --ondisk mmcblk --fstype=ext3 --label platform --align 1024
```
